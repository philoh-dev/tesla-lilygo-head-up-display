## components/adapters/esp_diagnostics/Kconfig
```kconfig
menu "Tesla Head-Up Display diagnostics"

    config TESLA_HEADUP_CAN_DIAGNOSTIC_CAPTURE
        bool "Log a bounded sample of received CAN frames"
        default n
        help
            Logs validated CAN bus, identifier, length, and payload values.
            Captures can contain vehicle-specific and sensitive information;
            enable this only during controlled diagnostics.

    config TESLA_HEADUP_CAN_DIAGNOSTIC_FRAMES_PER_SECOND
        int "Maximum logged CAN frames per second"
        depends on TESLA_HEADUP_CAN_DIAGNOSTIC_CAPTURE
        range 1 256
        default 32

endmenu
```

## components/adapters/lvgl_rgb/Kconfig
```kconfig
menu "Tesla Head-Up Display Newhaven RGB output"
    config TESLA_HEADUP_DISPLAY_RGB
        bool "Use Newhaven 800x480 RGB transport (DevKitC only)"
        default n
        depends on IDF_TARGET_ESP32S3

    if TESLA_HEADUP_DISPLAY_RGB
        config TESLA_HEADUP_RGB_FULL_ROAD_SCENE
            bool "Use full 800x480 road scene"
            depends on TESLA_HEADUP_DASHBOARD_LAYOUT_ROAD_SCENE && !TESLA_HEADUP_RGB_DIAGNOSTICS
            default y
            help
                Native full-panel composition, not bitmap scaling. Origin is
                fixed to (0,0). Disable to retain the 536x240 viewport.

        config TESLA_HEADUP_RGB_DIAGNOSTICS
            bool "Raw RGB diagnostic firmware (use rgb_diagnostics firmware mode)"
            default n

        if TESLA_HEADUP_RGB_DIAGNOSTICS
            config TESLA_HEADUP_RGB_DIAGNOSTIC_BRIGHTNESS
                int "Diagnostic backlight brightness percent"
                range 1 100
                default 25

            config TESLA_HEADUP_RGB_DIAGNOSTIC_MIRRORED
                bool "Mirror diagnostic output"
                default n
        endif

        config TESLA_HEADUP_RGB_ORIGIN_X
            int "Dashboard X before projection mirroring"
            range 0 264
            default 132

        config TESLA_HEADUP_RGB_ORIGIN_Y
            int "Dashboard Y"
            range 0 240
            default 0

        config TESLA_HEADUP_RGB_PCLK_HZ
            int "Newhaven Rev3A pixel clock (Hz)"
            range 28200000 40000000
            default 29200000
            help
                Rev3A specifies 28.2 MHz minimum and 29.2 MHz typical.
                Physical scanout is independent of application render rate.
                Initial 29.2 MHz operation still requires hardware validation.
    endif
endmenu
```

## components/adapters/lvgl_rm67162/Kconfig
```kconfig
menu "Tesla Head-Up Display RM67162 display"

    choice TESLA_HEADUP_DASHBOARD_LAYOUT
        prompt "Dashboard layout"
        default TESLA_HEADUP_DASHBOARD_LAYOUT_MINIMAL

        config TESLA_HEADUP_DASHBOARD_LAYOUT_MINIMAL
            bool "Minimal centered speed"

        config TESLA_HEADUP_DASHBOARD_LAYOUT_ROAD_SCENE
            bool "Road scene"
    endchoice

    config TESLA_HEADUP_DISPLAY_SPI_CLOCK_HZ
        int "Display QSPI clock frequency"
        default 75000000

    config TESLA_HEADUP_DISPLAY_BUFFER_LINES
        int "Lines in each LVGL DMA buffer"
        range 8 120
        default 40

    config TESLA_HEADUP_DISPLAY_PIN_SCK
        int "QSPI clock GPIO"
        default 47

    config TESLA_HEADUP_DISPLAY_PIN_DATA0
        int "QSPI data 0 GPIO"
        default 18

    config TESLA_HEADUP_DISPLAY_PIN_DATA1
        int "QSPI data 1 GPIO"
        default 7

    config TESLA_HEADUP_DISPLAY_PIN_DATA2
        int "QSPI data 2 GPIO"
        default 48

    config TESLA_HEADUP_DISPLAY_PIN_DATA3
        int "QSPI data 3 GPIO"
        default 5

    config TESLA_HEADUP_DISPLAY_PIN_CS
        int "Display chip-select GPIO"
        default 6

    config TESLA_HEADUP_DISPLAY_PIN_RESET
        int "Display reset GPIO"
        default 17

    config TESLA_HEADUP_DISPLAY_PIN_POWER
        int "Display power GPIO"
        default 38

    config TESLA_HEADUP_DISPLAY_PROJECTION_MIRRORED
        bool "Mirror the completed display for windshield projection"
        default y

endmenu
```

## firmware/main/Kconfig.projbuild
```kconfig
menu "Tesla Head-Up Display bring-up"

    config TESLA_HEADUP_DISPLAY_SELF_TEST
        bool "Run the display self-test instead of DashKit BLE"
        default n
        help
            Skip NimBLE initialization and publish deterministic synthetic
            telemetry through the normal dashboard pipeline. This mode is for
            physical display, animation, and performance validation only.

endmenu
```

## firmware/sdkconfig.defaults
```kconfig
CONFIG_BT_ENABLED=y
CONFIG_BT_NIMBLE_ENABLED=y
CONFIG_BT_NIMBLE_ROLE_CENTRAL=y
CONFIG_BT_NIMBLE_ROLE_OBSERVER=y
CONFIG_BT_NIMBLE_ROLE_PERIPHERAL=y
CONFIG_BT_NIMBLE_ROLE_BROADCASTER=n
CONFIG_BT_NIMBLE_NVS_PERSIST=y
CONFIG_BT_NIMBLE_MAX_CONNECTIONS=1
CONFIG_BT_NIMBLE_MAX_BONDS=3
CONFIG_BT_NIMBLE_HOST_TASK_STACK_SIZE=6144
CONFIG_ESP_MAIN_TASK_STACK_SIZE=8192
CONFIG_LV_FONT_MONTSERRAT_18=y
CONFIG_LV_FONT_MONTSERRAT_24=y
CONFIG_LV_FONT_MONTSERRAT_48=n
CONFIG_LV_FONT_DEFAULT_MONTSERRAT_24=y
CONFIG_LV_BUILD_EXAMPLES=n
CONFIG_LV_BUILD_DEMOS=n
```
